## conf/layer.conf
```bitbake
require obs.inc

BBPATH .= ":${LAYERDIR}"
  
BBFILES += "${LAYERDIR}/recipes-*/*/*.bbappend \
            ${LAYERDIR}/recipes-*/*/*.bb"

BBFILE_COLLECTIONS += "dtvkit-aml"
BBFILE_PATTERN_dtvkit-aml = "^${LAYERDIR}/"
BBFILE_PRIORITY_dtvkit-aml = "31"

LAYERVERSION_dtvkit-aml = "1"

LAYERSERIES_COMPAT_dtvkit-aml = "dunfell"

# These recipes will be replaced so exclude them
#BBMASK += "meta-dvb/recipes-multimedia/gstreamer/gst-plugins-rdk_%.bbappend"
BBMASK += "meta-rdk-voice/"
#BBMASK += "meta-rdk-aml/recipes-extended/amazon-prime-src/amazon-prime-src_4.0.bbappend"

# license directories.
#LICENSE_PATH += "${LAYERDIR}/licences"

require dtvkit.inc
```
